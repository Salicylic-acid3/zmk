## app/module/dts/bindings/kscan/zmk,kscan-gpio-matrix.yaml
```yaml
# Copyright (c) 2020, Pete Johanson
# SPDX-License-Identifier: MIT

description: GPIO keyboard matrix controller

compatible: "zmk,kscan-gpio-matrix"

include: kscan.yaml

properties:
  row-gpios:
    type: phandle-array
    required: true
  col-gpios:
    type: phandle-array
    required: true
  debounce-period:
    type: int
    required: false
    deprecated: true
    description: Deprecated. Use debounce-press-ms and debounce-release-ms instead.
  debounce-press-ms:
    type: int
    default: 5
    description: Debounce time for key press in milliseconds. Use 0 for eager debouncing.
  debounce-release-ms:
    type: int
    default: 5
    description: Debounce time for key release in milliseconds.
  debounce-release-held-ms:
    type: int
    default: 0
    description: |
      Debounce time for the release of a key that has been held for at least
      debounce-held-threshold-ms, in milliseconds. 0 (the default) uses
      debounce-release-ms for every release. A longer window here absorbs a
      contact that opens for a moment while a key is held (snap-action and
      mouse switches do this) without touching quick double taps, which
      start from a short press.
  debounce-held-threshold-ms:
    type: int
    default: 0
    description: How long a key must have been pressed, in milliseconds, before debounce-release-held-ms applies.
  debounce-scan-period-ms:
    type: int
    default: 1
    description: Time between reads in milliseconds when any key is pressed.
  poll-period-ms:
    type: int
    default: 10
    description: Time between reads in milliseconds when no key is pressed and ZMK_KSCAN_MATRIX_POLLING is enabled.
  diode-direction:
    type: string
    default: row2col
    enum:
      - row2col
      - col2row
```
